#include "tegra194-xavier-nx-cti-NGX006.dts"
#include "common/tegra194-xavier-nx-cti-NGX006-LI-IMX304-2CAM.dtsi"

/{
    nvidia,dtsfilename = "tegra194-xavier-nx-cti-NGX006-LI-IMX304-2CAM.dts";
    nvidia,dtbbuildtime = __DATE__, __TIME__;
	
};

