#include "tegra194-xavier-nx-cti-NGX004.dts"
//#include "common/tegra194-camera-jakku-ar0234.dtsi"
#include "common/tegra194-xavier-nx-cti-NGX003-ECON-AR0234.dtsi"

/{
    nvidia,dtsfilename = "tegra194-xavier-nx-cti-NGX004-ECON-AR0234-2CAM.dts";
    nvidia,dtbbuildtime = __DATE__, __TIME__;
	
};
#if LINUX_VERSION >= 414
#include <tegra194-linux-4.14.dtsi>
#endif

