#include "tegra194-xavier-nx-cti-NGX007.dts" 
#include "common/tegra194-xavier-nx-cti-NGX007-FSM-IMX415-3CAM.dtsi" 
/{
    nvidia,dtsfilename = "tegra194-xavier-nx-cti-NGX007-FSM-IMX415-3CAM.dts";
    nvidia,dtbbuildtime = __DATE__, __TIME__;
};
