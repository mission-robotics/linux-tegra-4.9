#include "tegra194-xavier-nx-cti-NGX006.dts"
#include "common/tegra194-xavier-nx-cti-NGX006-LI-IMX390-mux.dtsi"

/{
    nvidia,dtsfilename = "tegra194-xavier-nx-cti-NGX006-LI-IMX390-4CAM.dts";
    nvidia,dtbbuildtime = __DATE__, __TIME__;
	
};

