#include "tegra194-xavier-nx-cti-NGX007.dts" 
#include "common/tegra194-xavier-nx-cti-NGX007-FSM-IMX577-3CAM.dtsi" 
/{
    nvidia,dtsfilename = "tegra194-xavier-nx-cti-NGX007-FSM-IMX577-3CAM.dts";
    nvidia,dtbbuildtime = __DATE__, __TIME__;
};
