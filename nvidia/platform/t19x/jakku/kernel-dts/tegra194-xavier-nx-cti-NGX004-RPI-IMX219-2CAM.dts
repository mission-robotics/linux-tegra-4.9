#include "tegra194-xavier-nx-cti-NGX004.dts"
#include "common/tegra194-xavier-nx-cti-NGX003-RPI-IMX219-mux.dtsi"

/{

	nvidia,dtsfilename = "tegra194-xavier-nx-cti-NGX004-RPI-IMX219-2CAM.dts";
	nvidia,dtbbuildtime = __DATE__, __TIME__;

};
