#define SENSOR_MODE0						mclk_khz = "24000";		\
								num_lanes = "2";		\
								phy_mode = "DPHY";		\
								discontinuous_clk = "no";	\
								dpcm_enable = "false";	\
								cil_settletime = "0";	\
								dynamic_pixel_bit_depth = "16";	\
								csi_pixel_bit_depth = "16";	\
								mode_type = "yuv";	\
								pixel_phase = "uyvy"; \
								active_w = "640";	\
								active_h = "480";	\
								readout_orientation = "0";	\
								deskew_initial_enable = "false";	\
								pix_clk_hz = "1152000000";		\
								line_length = "640";	\
								inherent_gain = "1";	\
								mclk_multiplier = "6.67";	\
								min_gain_val = "1";	\
								max_gain_val = "8";	\
								min_hdr_ratio = "1";	\
								max_hdr_ratio = "1";	\
								min_framerate = "1";	\
								max_framerate = "58";	\
								min_exp_time = "10";	\
								max_exp_time = "5000";
	
#define SENSOR_MODE1			mclk_khz = "24000";		\
								num_lanes = "2";	\
								phy_mode = "DPHY";		\
								discontinuous_clk = "no";	\
								dpcm_enable = "false";	\
								cil_settletime = "0";	\
								dynamic_pixel_bit_depth = "16";	\
								csi_pixel_bit_depth = "16";	\
								mode_type = "yuv";	\
								pixel_phase = "uyvy"; \
								active_w = "640";	\
								active_h = "480";	\
								readout_orientation = "0";	\
								deskew_initial_enable = "false";	\
								pix_clk_hz = "1152000000";		\
								line_length = "640";	\
								inherent_gain = "1";	\
								mclk_multiplier = "6.67";	\
								min_gain_val = "1";	\
								max_gain_val = "8";	\
								min_hdr_ratio = "1";	\
								max_hdr_ratio = "1";	\
								min_framerate = "1";	\
								max_framerate = "45";	\
								min_exp_time = "10";	\
								max_exp_time = "5000";	
								
#define SENSOR_MODE2			mclk_khz = "24000"; \
								num_lanes = "2";		\
								phy_mode = "DPHY";		\
								discontinuous_clk = "no";	\
								dpcm_enable = "false";	\
								cil_settletime = "0";	\
								dynamic_pixel_bit_depth = "16";	\
								csi_pixel_bit_depth = "16";	\
								mode_type = "yuv";	\
								pixel_phase = "uyvy"; \
								active_w = "960";	\
								active_h = "540";	\
								readout_orientation = "0";	\
								deskew_initial_enable = "false";	\
								pix_clk_hz = "1152000000";		\
								line_length = "960";	\
								inherent_gain = "1";	\
								mclk_multiplier = "6.67";	\
								min_gain_val = "1";	\
								max_gain_val = "8";	\
								min_hdr_ratio = "1";	\
								max_hdr_ratio = "1";	\
								min_framerate = "1";	\
								max_framerate = "58";	\
								min_exp_time = "10";	\
								max_exp_time = "5000";	
									
#define SENSOR_MODE3			mclk_khz = "24000";		\
								num_lanes = "2";		\
								phy_mode = "DPHY";		\
								discontinuous_clk = "no";	\
								dpcm_enable = "false";	\
								cil_settletime = "0";	\
								dynamic_pixel_bit_depth = "16";	\
								csi_pixel_bit_depth = "16";	\
								mode_type = "yuv";	\
								pixel_phase = "uyvy"; \
								active_w = "960";	\
								active_h = "540";	\
								readout_orientation = "0";	\
								deskew_initial_enable = "false";	\
								pix_clk_hz = "1152000000";		\
								line_length = "960";	\
								inherent_gain = "1";	\
								mclk_multiplier = "6.67";	\
								min_gain_val = "1";	\
								max_gain_val = "8";	\
								min_hdr_ratio = "1";	\
								max_hdr_ratio = "1";	\
								min_framerate = "1";	\
								max_framerate = "30";	\
								min_exp_time = "10";	\
								max_exp_time = "5000";
								
#define SENSOR_MODE4			mclk_khz = "24000"; \
								num_lanes = "2";		\
								phy_mode = "DPHY";		\
								discontinuous_clk = "no";	\
								dpcm_enable = "false";	\
								cil_settletime = "0";	\
								dynamic_pixel_bit_depth = "16";	\
								csi_pixel_bit_depth = "16";	\
								mode_type = "yuv";	\
								pixel_phase = "uyvy"; \
								active_w = "1280";	\
								active_h = "720";	\
								readout_orientation = "0";	\
								deskew_initial_enable = "false";	\
								pix_clk_hz = "1152000000";		\
								line_length = "1280";	\
								inherent_gain = "1";	\
								mclk_multiplier = "6.67";	\
								min_gain_val = "1";	\
								max_gain_val = "8";	\
								min_hdr_ratio = "1";	\
								max_hdr_ratio = "1";	\
								min_framerate = "1";	\
								max_framerate = "45";	\
								min_exp_time = "10";	\
								max_exp_time = "5000";

#define SENSOR_MODE5			mclk_khz = "24000"; \
								num_lanes = "2";		\
								phy_mode = "DPHY";		\
								discontinuous_clk = "no";	\
								dpcm_enable = "false";	\
								cil_settletime = "0";	\
								dynamic_pixel_bit_depth = "16";	\
								csi_pixel_bit_depth = "16";	\
								mode_type = "yuv";	\
								pixel_phase = "uyvy"; \
								active_w = "1280";	\
								active_h = "960";	\
								readout_orientation = "0";	\
								deskew_initial_enable = "false";	\
								pix_clk_hz = "1152000000";		\
								line_length = "1280";	\
								inherent_gain = "1";	\
								mclk_multiplier = "6.67";	\
								min_gain_val = "1";	\
								max_gain_val = "8";	\
								min_hdr_ratio = "1";	\
								max_hdr_ratio = "1";	\
								min_framerate = "1";	\
								max_framerate = "30";	\
								min_exp_time = "10";	\
								max_exp_time = "5000";

#define SENSOR_MODE6			mclk_khz = "24000"; \
								num_lanes = "2";		\
								phy_mode = "DPHY";		\
								discontinuous_clk = "no";	\
								dpcm_enable = "false";	\
								cil_settletime = "0";	\
								dynamic_pixel_bit_depth = "16";	\
								csi_pixel_bit_depth = "16";	\
								mode_type = "yuv";	\
								pixel_phase = "uyvy"; \
								active_w = "1920";	\
								active_h = "1080";	\
								readout_orientation = "0";	\
								deskew_initial_enable = "false";	\
								pix_clk_hz = "1152000000";		\
								line_length = "1920";	\
								inherent_gain = "1";	\
								mclk_multiplier = "6.67";	\
								min_gain_val = "1";	\
								max_gain_val = "8";	\
								min_hdr_ratio = "1";	\
								max_hdr_ratio = "1";	\
								min_framerate = "1";	\
								max_framerate = "30";	\
								min_exp_time = "10";	\
								max_exp_time = "5000";								
	
/{
    nvidia,dtsfilename = "tegra194-cti-camera-ar0230-4cam-modes-header.dtsi";
    nvidia,dtbbuildtime = __DATE__, __TIME__;
};
