#define  VI_ADDR   vi@15c10000
#define  NVCSI_ADDR   nvcsi@15a00000
#define  NUM_MIPI_CHAN   4
#define  COMPATIBLE_STRING   "framos,imx297"


#define  I2C_ADDR0   i2c@3180000

#define  I2C_EXPANDER_ADDR0   tca9548@70

#define  BUS_WIDTH0   1
#define  BUS_WIDTH1   1
#define  BUS_WIDTH2   1
#define  BUS_WIDTH3   1

#define  NUM_OF_LANES0   "1"
#define  NUM_OF_LANES1   "1"
#define  NUM_OF_LANES2   "1"
#define  NUM_OF_LANES3   "1"

#define CSI_PORT_INDEX0  0
#define CSI_PORT_INDEX1  2
#define CSI_PORT_INDEX2  3
#define CSI_PORT_INDEX3  4

#define VI_PORT_INDEX0  0
#define VI_PORT_INDEX1  2
#define VI_PORT_INDEX2  3
#define VI_PORT_INDEX3  4

#define  I2C0   i2c@0
#define  I2C1   i2c@1
#define  I2C2   i2c@2
#define  I2C3   i2c@3

#define  I2C_NODE0_REG   0x1a
#define  I2C_NODE1_REG   0x1a
#define  SENSOR_MODEL   "imx297"


#define  I2C0_NODE0    fsm_imx297_a@1a
#define  I2C1_NODE0    fsm_imx297_c@1a
#define  I2C2_NODE0    fsm_imx297_d@1a
#define  I2C3_NODE0    fsm_imx297_e@1a

#define  I2C0_NODE0_SINTERFACE    "serial_a"
#define  I2C1_NODE0_SINTERFACE    "serial_c"
#define  I2C2_NODE0_SINTERFACE    "serial_d"
#define  I2C3_NODE0_SINTERFACE    "serial_e"

#define  I2C0_NODE0_PORT_INDEX    0
#define  I2C1_NODE0_PORT_INDEX    2
#define  I2C2_NODE0_PORT_INDEX    3
#define  I2C3_NODE0_PORT_INDEX    4

#define TEGRA_CAM_PLAT_DATA 		num_csi_lanes = <4>; \
								max_lane_speed = <1500000>; \
								min_bits_per_pixel = <10>; \
								vi_peak_byte_per_pixel = <2>; \
								vi_bw_margin_pct = <25>; \
								max_pixel_rate = <240000>; \
								isp_peak_byte_per_pixel = <5>; \
								isp_bw_margin_pct = <25>;

#define  MODULE0_BADGE    "imx297_front_fsm_imx297"
#define  MODULE1_BADGE    "imx297_rear_fsm_imx297"
#define  MODULE2_BADGE    "imx297_centerright_fsm_imx297"
#define  MODULE3_BADGE    "imx297_centerleft_fsm_imx297"

#define MODULE0_DEVNAME  "imx297 30-001a"
#define MODULE1_DEVNAME  "imx297 31-001a"
#define MODULE2_DEVNAME  "imx297 32-001a"
#define MODULE3_DEVNAME  "imx297 33-001a"

#define PROC_DEVICE_TREE0  "/proc/device-tree/i2c@3180000/tca9548@70/i2c@0/fsm_imx297_a@1a"
#define PROC_DEVICE_TREE1  "/proc/device-tree/i2c@3180000/tca9548@70/i2c@1/fsm_imx297_c@1a"
#define PROC_DEVICE_TREE2  "/proc/device-tree/i2c@3180000/tca9548@70/i2c@2/fsm_imx297_d@1a"
#define PROC_DEVICE_TREE3  "/proc/device-tree/i2c@3180000/tca9548@70/i2c@3/fsm_imx297_e@1a"


/{
nvidia,dtsfilename = "tegra194-cti-camera-fsm-imx297-4cam-1mux-1sensor-header.dtsi";
nvidia,dtbbuildtime = __DATE__, __TIME__;
};