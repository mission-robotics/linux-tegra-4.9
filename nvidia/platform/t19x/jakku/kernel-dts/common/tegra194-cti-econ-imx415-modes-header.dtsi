#define SENSOR_MODE0			mclk_khz = "37125"; \
								discontinuous_clk = "no"; \
								cil_settletime = "0"; \
								dpcm_enable = "false"; \
								active_h = "2160"; \
								active_w = "3840"; \
								mode_type = "bayer"; \
								readout_orientation = "0"; \
								csi_pixel_bit_depth = "12"; \
								dynamic_pixel_bit_depth = "12"; \
								pixel_phase = "gbrg"; \
								line_length = "887"; \
								mclk_multiplier = "1"; \
								pix_clk_hz = "693000000"; \
								inherent_gain = "1"; \
								min_gain_val = "0"; \
								max_gain_val = "300"; \
								min_exp_time = "450"; \
								max_exp_time = "200000"; \
								min_hdr_ratio = "1"; \
								max_hdr_ratio = "1"; \
								min_framerate = "5000000"; \
								max_framerate = "37000000"; \
								embedded_metadata_height = "1"; \
								gain_factor = "10"; \
								default_gain = "0"; \
								step_gain_val = "3"; \
								exposure_factor = "1000000"; \
								default_exp_time = "27027"; \
								step_exp_time = "1"; \
								framerate_factor = "1000000"; \
								default_framerate = "37000000"; \
								step_framerate = "1"; 
								
#define SENSOR_MODE1			mclk_khz = "37125"; \
								discontinuous_clk = "no"; \
								cil_settletime = "0"; \
								dpcm_enable = "false"; \
								active_h = "2160"; \
								active_w = "3840"; \
								mode_type = "bayer"; \
								readout_orientation = "0"; \
								csi_pixel_bit_depth = "10"; \
								dynamic_pixel_bit_depth = "10"; \
								pixel_phase = "gbrg"; \
								line_length = "746"; \
								mclk_multiplier = "1"; \
								pix_clk_hz = "831600000"; \
								inherent_gain = "1"; \
								min_gain_val = "0"; \
								max_gain_val = "300"; \
								min_exp_time = "450"; \
								max_exp_time = "200000"; \
								min_hdr_ratio = "1"; \
								max_hdr_ratio = "1"; \
								min_framerate = "5000000"; \
								max_framerate = "44000000"; \
								embedded_metadata_height = "1"; \
								gain_factor = "10"; \
								default_gain = "0"; \
								step_gain_val = "3"; \
								exposure_factor = "1000000"; \
								default_exp_time = "22727"; \
								step_exp_time = "1"; \
								framerate_factor = "1000000"; \
								default_framerate = "44000000"; \
								step_framerate = "1"; 
								
#define SENSOR_MODE2			mclk_khz = "37125"; \
								discontinuous_clk = "no"; \
								cil_settletime = "0"; \
								dpcm_enable = "false"; \
								active_h = "1096"; \
								active_w = "1944"; \
								mode_type = "bayer"; \
								readout_orientation = "0"; \
								csi_pixel_bit_depth = "12"; \
								dynamic_pixel_bit_depth = "12"; \
								pixel_phase = "gbrg"; \
								line_length = "470"; \
								mclk_multiplier = "1"; \
								pix_clk_hz = "831600000"; \
								inherent_gain = "1"; \
								min_gain_val = "0"; \
								max_gain_val = "300"; \
								min_exp_time = "450"; \
								max_exp_time = "200000"; \
								min_hdr_ratio = "1"; \
								max_hdr_ratio = "1"; \
								min_framerate = "5000000"; \
								max_framerate = "70000000"; \
								embedded_metadata_height = "1"; \
								gain_factor = "10"; \
								default_gain = "0"; \
								step_gain_val = "3"; \
								exposure_factor = "1000000"; \
								default_exp_time = "14285"; \
								step_exp_time = "1"; \
								framerate_factor = "1000000"; \
								default_framerate = "70000000"; \
								step_framerate = "1"; 
								
#define SENSOR_MODE3			mclk_khz = "37125"; \
								discontinuous_clk = "no"; \
								cil_settletime = "0"; \
								dpcm_enable = "false"; \
								active_h = "732"; \
								active_w = "1296"; \
								mode_type = "bayer"; \
								readout_orientation = "0"; \
								csi_pixel_bit_depth = "12"; \
								dynamic_pixel_bit_depth = "12"; \
								pixel_phase = "gbrg"; \
								line_length = "470"; \
								mclk_multiplier = "1"; \
								pix_clk_hz = "831600000"; \
								inherent_gain = "1"; \
								min_gain_val = "0"; \
								max_gain_val = "300"; \
								min_exp_time = "450"; \
								max_exp_time = "200000"; \
								min_hdr_ratio = "1"; \
								max_hdr_ratio = "1"; \
								min_framerate = "5000000"; \
								max_framerate = "104000000"; \
								embedded_metadata_height = "1"; \
								gain_factor = "10"; \
								default_gain = "0"; \
								step_gain_val = "3"; \
								exposure_factor = "1000000"; \
								default_exp_time = "9615"; \
								step_exp_time = "1"; \
								framerate_factor = "1000000"; \
								default_framerate = "104000000"; \
								step_framerate = "1"; 
								
#define CAM_DATA			physical_w = "5.60"; \
								physical_h = "3.175"; \
								use_decibel_gain = "true"; \
								use_sensor_mode_id = "true"; \
								use_dol_wdr_mode = "false"; \
								use_master_slave_mode = "false"; \
								limit_analog_gain = "true"; \
								camera_mipi_lanes = /bits/ 8 <2>; \
								mipi-clk-configurable; \
								camera_mipi_clk = /bits/ 16 <2000>; 
								
#define SENSOR_MODE4			mclk_khz = "37125"; \
								discontinuous_clk = "no"; \
								cil_settletime = "0"; \
								dpcm_enable = "false"; \
								active_h = "2160"; \
								active_w = "3840"; \
								mode_type = "bayer"; \
								readout_orientation = "0"; \
								csi_pixel_bit_depth = "12"; \
								dynamic_pixel_bit_depth = "12"; \
								pixel_phase = "gbrg"; \
								line_length = "887"; \
								mclk_multiplier = "1"; \
								pix_clk_hz = "693000000"; \
								inherent_gain = "1"; \
								min_gain_val = "0"; \
								max_gain_val = "300"; \
								min_exp_time = "450"; \
								max_exp_time = "200000"; \
								min_hdr_ratio = "1"; \
								max_hdr_ratio = "1"; \
								min_framerate = "5000000"; \
								max_framerate = "37000000"; \
								embedded_metadata_height = "1"; \
								gain_factor = "10"; \
								default_gain = "0"; \
								step_gain_val = "3"; \
								exposure_factor = "1000000"; \
								default_exp_time = "27027"; \
								step_exp_time = "1"; \
								framerate_factor = "1000000"; \
								default_framerate = "37000000"; \
								step_framerate = "1"; 
								
#define SENSOR_MODE5			mclk_khz = "37125"; \
								discontinuous_clk = "no"; \
								cil_settletime = "0"; \
								dpcm_enable = "false"; \
								active_h = "2160"; \
								active_w = "3840"; \
								mode_type = "bayer"; \
								readout_orientation = "0"; \
								csi_pixel_bit_depth = "10"; \
								dynamic_pixel_bit_depth = "10"; \
								pixel_phase = "gbrg"; \
								line_length = "746"; \
								mclk_multiplier = "1"; \
								pix_clk_hz = "831600000"; \
								inherent_gain = "1"; \
								min_gain_val = "0"; \
								max_gain_val = "300"; \
								min_exp_time = "450"; \
								max_exp_time = "200000"; \
								min_hdr_ratio = "1"; \
								max_hdr_ratio = "1"; \
								min_framerate = "5000000"; \
								max_framerate = "44000000"; \
								embedded_metadata_height = "1"; \
								gain_factor = "10"; \
								default_gain = "0"; \
								step_gain_val = "3"; \
								exposure_factor = "1000000"; \
								default_exp_time = "22727"; \
								step_exp_time = "1"; \
								framerate_factor = "1000000"; \
								default_framerate = "44000000"; \
								step_framerate = "1"; 
								
#define SENSOR_MODE2			mclk_khz = "37125"; \
								discontinuous_clk = "no"; \
								cil_settletime = "0"; \
								dpcm_enable = "false"; \
								active_h = "1096"; \
								active_w = "1944"; \
								mode_type = "bayer"; \
								readout_orientation = "0"; \
								csi_pixel_bit_depth = "12"; \
								dynamic_pixel_bit_depth = "12"; \
								pixel_phase = "gbrg"; \
								line_length = "470"; \
								mclk_multiplier = "1"; \
								pix_clk_hz = "831600000"; \
								inherent_gain = "1"; \
								min_gain_val = "0"; \
								max_gain_val = "300"; \
								min_exp_time = "450"; \
								max_exp_time = "200000"; \
								min_hdr_ratio = "1"; \
								max_hdr_ratio = "1"; \
								min_framerate = "5000000"; \
								max_framerate = "70000000"; \
								embedded_metadata_height = "1"; \
								gain_factor = "10"; \
								default_gain = "0"; \
								step_gain_val = "3"; \
								exposure_factor = "1000000"; \
								default_exp_time = "14285"; \
								step_exp_time = "1"; \
								framerate_factor = "1000000"; \
								default_framerate = "70000000"; \
								step_framerate = "1"; 
								
#define SENSOR_MODE3			mclk_khz = "37125"; \
								discontinuous_clk = "no"; \
								cil_settletime = "0"; \
								dpcm_enable = "false"; \
								active_h = "732"; \
								active_w = "1296"; \
								mode_type = "bayer"; \
								readout_orientation = "0"; \
								csi_pixel_bit_depth = "12"; \
								dynamic_pixel_bit_depth = "12"; \
								pixel_phase = "gbrg"; \
								line_length = "470"; \
								mclk_multiplier = "1"; \
								pix_clk_hz = "831600000"; \
								inherent_gain = "1"; \
								min_gain_val = "0"; \
								max_gain_val = "300"; \
								min_exp_time = "450"; \
								max_exp_time = "200000"; \
								min_hdr_ratio = "1"; \
								max_hdr_ratio = "1"; \
								min_framerate = "5000000"; \
								max_framerate = "104000000"; \
								embedded_metadata_height = "1"; \
								gain_factor = "10"; \
								default_gain = "0"; \
								step_gain_val = "3"; \
								exposure_factor = "1000000"; \
								default_exp_time = "9615"; \
								step_exp_time = "1"; \
								framerate_factor = "1000000"; \
								default_framerate = "104000000"; \
								step_framerate = "1"; 
								
#define CAM_DATA			physical_w = "5.60"; \
								physical_h = "3.175"; \
								use_decibel_gain = "true"; \
								use_sensor_mode_id = "true"; \
								use_dol_wdr_mode = "false"; \
								use_master_slave_mode = "false"; \
								limit_analog_gain = "true"; \
								camera_mipi_lanes = /bits/ 8 <2>; \
								mipi-clk-configurable; \
								camera_mipi_clk = /bits/ 16 <2000>; 
								
/{
	nvidia,dtsfilename = "/home/sweng/econ/e-CAM80_CUNX_JETSON_L4T32.5.1_15-APR-2021_R02/Kernel/e-CAM80_CUNX_JETSON_XAVIER_NX_L4T32.5.1_dtb.patch";
	nvidia,dtbbuildtime = __DATE__, __TIME__;
};