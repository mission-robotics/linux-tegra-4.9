#define SENSOR_MODE0			mclk_khz = "37125"; \
								discontinuous_clk = "no"; \
								cil_settletime = "0"; \
								dpcm_enable = "false"; \
								active_h = "3008"; \
								active_w = "4128"; \
								mode_type = "bayer"; \
								readout_orientation = "0"; \
								csi_pixel_bit_depth = "12"; \
								dynamic_pixel_bit_depth = "12"; \
								pixel_phase = "rggb"; \
								line_length = "4512"; \
								mclk_multiplier = "80.80"; \
								pix_clk_hz = "3000000000"; \
								inherent_gain = "1"; \
								min_gain_val = "0"; \
								max_gain_val = "480"; \
								min_exp_time = "22"; \
								max_exp_time = "660000"; \
								min_hdr_ratio = "1"; \
								max_hdr_ratio = "1"; \
								min_framerate = "1500000"; \
								max_framerate = "15000000"; \
								embedded_metadata_height = "1"; \
								gain_factor = "10"; \
								default_gain = "0"; \
								step_gain_val = "1"; \
								exposure_factor = "1000000"; \
								default_exp_time = "10000"; \
								step_exp_time = "1"; \
								framerate_factor = "1000000"; \
								default_framerate = "15000000"; \
								step_framerate = "1"; 
								
#define SENSOR_MODE1			mclk_khz = "37125"; \
								discontinuous_clk = "no"; \
								cil_settletime = "0"; \
								dpcm_enable = "false"; \
								active_h = "2160"; \
								active_w = "3840"; \
								mode_type = "bayer"; \
								readout_orientation = "0"; \
								csi_pixel_bit_depth = "12"; \
								dynamic_pixel_bit_depth = "12"; \
								pixel_phase = "rggb"; \
								line_length = "4512"; \
								mclk_multiplier = "80.80"; \
								pix_clk_hz = "3000000000"; \
								inherent_gain = "1"; \
								min_gain_val = "0"; \
								max_gain_val = "480"; \
								min_exp_time = "22"; \
								max_exp_time = "660000"; \
								min_hdr_ratio = "1"; \
								max_hdr_ratio = "1"; \
								min_framerate = "1500000"; \
								max_framerate = "20000000"; \
								embedded_metadata_height = "1"; \
								gain_factor = "10"; \
								default_gain = "0"; \
								step_gain_val = "1"; \
								exposure_factor = "1000000"; \
								default_exp_time = "10000"; \
								step_exp_time = "1"; \
								framerate_factor = "1000000"; \
								default_framerate = "20000000"; \
								step_framerate = "1"; 
								
#define SENSOR_MODE2			mclk_khz = "37125"; \
								discontinuous_clk = "no"; \
								cil_settletime = "0"; \
								dpcm_enable = "false"; \
								active_h = "1080"; \
								active_w = "1920"; \
								mode_type = "bayer"; \
								readout_orientation = "0"; \
								csi_pixel_bit_depth = "12"; \
								dynamic_pixel_bit_depth = "12"; \
								pixel_phase = "rggb"; \
								line_length = "4512"; \
								mclk_multiplier = "80.80"; \
								pix_clk_hz = "3000000000"; \
								inherent_gain = "1"; \
								min_gain_val = "0"; \
								max_gain_val = "480"; \
								min_exp_time = "11"; \
								max_exp_time = "660000"; \
								min_hdr_ratio = "1"; \
								max_hdr_ratio = "1"; \
								min_framerate = "1500000"; \
								max_framerate = "78000000"; \
								embedded_metadata_height = "1"; \
								gain_factor = "10"; \
								default_gain = "0"; \
								step_gain_val = "1"; \
								exposure_factor = "1000000"; \
								default_exp_time = "10000"; \
								step_exp_time = "1"; \
								framerate_factor = "1000000"; \
								default_framerate = "78000000"; \
								step_framerate = "1"; 
								
#define SENSOR_MODE3			mclk_khz = "37125"; \
								discontinuous_clk = "no"; \
								cil_settletime = "0"; \
								dpcm_enable = "false"; \
								active_h = "3008"; \
								active_w = "4128"; \
								mode_type = "bayer"; \
								readout_orientation = "0"; \
								csi_pixel_bit_depth = "10"; \
								dynamic_pixel_bit_depth = "10"; \
								pixel_phase = "rggb"; \
								line_length = "4512"; \
								mclk_multiplier = "80.80"; \
								pix_clk_hz = "3000000000"; \
								inherent_gain = "1"; \
								min_gain_val = "0"; \
								max_gain_val = "480"; \
								min_exp_time = "18"; \
								max_exp_time = "660000"; \
								min_hdr_ratio = "1"; \
								max_hdr_ratio = "1"; \
								min_framerate = "1500000"; \
								max_framerate = "17000000"; \
								embedded_metadata_height = "1"; \
								gain_factor = "10"; \
								default_gain = "0"; \
								step_gain_val = "1"; \
								exposure_factor = "1000000"; \
								default_exp_time = "10000"; \
								step_exp_time = "1"; \
								framerate_factor = "1000000"; \
								default_framerate = "17000000"; \
								step_framerate = "1"; 
								
#define SENSOR_MODE4			mclk_khz = "37125"; \
								discontinuous_clk = "no"; \
								cil_settletime = "0"; \
								dpcm_enable = "false"; \
								active_h = "2160"; \
								active_w = "3840"; \
								mode_type = "bayer"; \
								readout_orientation = "0"; \
								csi_pixel_bit_depth = "10"; \
								dynamic_pixel_bit_depth = "10"; \
								pixel_phase = "rggb"; \
								line_length = "4512"; \
								mclk_multiplier = "80.80"; \
								pix_clk_hz = "3000000000"; \
								inherent_gain = "1"; \
								min_gain_val = "0"; \
								max_gain_val = "480"; \
								min_exp_time = "18"; \
								max_exp_time = "660000"; \
								min_hdr_ratio = "1"; \
								max_hdr_ratio = "1"; \
								min_framerate = "1500000"; \
								max_framerate = "24000000"; \
								embedded_metadata_height = "1"; \
								gain_factor = "10"; \
								default_gain = "0"; \
								step_gain_val = "1"; \
								exposure_factor = "1000000"; \
								default_exp_time = "10000"; \
								step_exp_time = "1"; \
								framerate_factor = "1000000"; \
								default_framerate = "24000000"; \
								step_framerate = "1"; 
								
#define SENSOR_MODE5			mclk_khz = "37125"; \
								discontinuous_clk = "no"; \
								cil_settletime = "0"; \
								dpcm_enable = "false"; \
								active_h = "1080"; \
								active_w = "1920"; \
								mode_type = "bayer"; \
								readout_orientation = "0"; \
								csi_pixel_bit_depth = "10"; \
								dynamic_pixel_bit_depth = "10"; \
								pixel_phase = "rggb"; \
								line_length = "4512"; \
								mclk_multiplier = "80.80"; \
								pix_clk_hz = "3000000000"; \
								inherent_gain = "1"; \
								min_gain_val = "0"; \
								max_gain_val = "480"; \
								min_exp_time = "10"; \
								max_exp_time = "660000"; \
								min_hdr_ratio = "1"; \
								max_hdr_ratio = "1"; \
								min_framerate = "1500000"; \
								max_framerate = "92000000"; \
								embedded_metadata_height = "1"; \
								gain_factor = "10"; \
								default_gain = "0"; \
								step_gain_val = "1"; \
								exposure_factor = "1000000"; \
								default_exp_time = "10000"; \
								step_exp_time = "1"; \
								framerate_factor = "1000000"; \
								default_framerate = "92000000"; \
								step_framerate = "1"; 
								
#define SENSOR_MODE6			mclk_khz = "37125"; \
								discontinuous_clk = "no"; \
								cil_settletime = "0"; \
								dpcm_enable = "false"; \
								active_h = "3008"; \
								active_w = "4128"; \
								mode_type = "bayer"; \
								readout_orientation = "0"; \
								csi_pixel_bit_depth = "8"; \
								dynamic_pixel_bit_depth = "8"; \
								pixel_phase = "rggb"; \
								line_length = "4512"; \
								mclk_multiplier = "80.80"; \
								pix_clk_hz = "3000000000"; \
								inherent_gain = "1"; \
								min_gain_val = "0"; \
								max_gain_val = "480"; \
								min_exp_time = "15"; \
								max_exp_time = "660000"; \
								min_hdr_ratio = "1"; \
								max_hdr_ratio = "1"; \
								min_framerate = "1500000"; \
								max_framerate = "22000000"; \
								embedded_metadata_height = "1"; \
								gain_factor = "10"; \
								default_gain = "0"; \
								step_gain_val = "1"; \
								exposure_factor = "1000000"; \
								default_exp_time = "10000"; \
								step_exp_time = "1"; \
								framerate_factor = "1000000"; \
								default_framerate = "22000000"; \
								step_framerate = "1"; 
								
#define SENSOR_MODE7			mclk_khz = "37125"; \
								discontinuous_clk = "no"; \
								cil_settletime = "0"; \
								dpcm_enable = "false"; \
								active_h = "2160"; \
								active_w = "3840"; \
								mode_type = "bayer"; \
								readout_orientation = "0"; \
								csi_pixel_bit_depth = "8"; \
								dynamic_pixel_bit_depth = "8"; \
								pixel_phase = "rggb"; \
								line_length = "4512"; \
								mclk_multiplier = "80.80"; \
								pix_clk_hz = "3000000000"; \
								inherent_gain = "1"; \
								min_gain_val = "0"; \
								max_gain_val = "480"; \
								min_exp_time = "15"; \
								max_exp_time = "660000"; \
								min_hdr_ratio = "1"; \
								max_hdr_ratio = "1"; \
								min_framerate = "1500000"; \
								max_framerate = "30000000"; \
								embedded_metadata_height = "1"; \
								gain_factor = "10"; \
								default_gain = "0"; \
								step_gain_val = "1"; \
								exposure_factor = "1000000"; \
								default_exp_time = "10000"; \
								step_exp_time = "1"; \
								framerate_factor = "1000000"; \
								default_framerate = "30000000"; \
								step_framerate = "1"; 
								
#define SENSOR_MODE8			mclk_khz = "37125"; \
								discontinuous_clk = "no"; \
								cil_settletime = "0"; \
								dpcm_enable = "false"; \
								active_h = "1080"; \
								active_w = "1920"; \
								mode_type = "bayer"; \
								readout_orientation = "0"; \
								csi_pixel_bit_depth = "8"; \
								dynamic_pixel_bit_depth = "8"; \
								pixel_phase = "rggb"; \
								line_length = "4512"; \
								mclk_multiplier = "80.80"; \
								pix_clk_hz = "3000000000"; \
								inherent_gain = "1"; \
								min_gain_val = "0"; \
								max_gain_val = "480"; \
								min_exp_time = "8"; \
								max_exp_time = "660000"; \
								min_hdr_ratio = "1"; \
								max_hdr_ratio = "1"; \
								min_framerate = "1500000"; \
								max_framerate = "113000000"; \
								embedded_metadata_height = "1"; \
								gain_factor = "10"; \
								default_gain = "0"; \
								step_gain_val = "1"; \
								exposure_factor = "1000000"; \
								default_exp_time = "10000"; \
								step_exp_time = "1"; \
								framerate_factor = "1000000"; \
								default_framerate = "113000000"; \
								step_framerate = "1"; 
								
/{
	nvidia,dtsfilename = "../../../../framos/FRAMOS_IMX565-Driver-Source_Jetson-Xavier-NX/patch/imx565_jakku_dtree.patch";
	nvidia,dtbbuildtime = __DATE__, __TIME__;
};