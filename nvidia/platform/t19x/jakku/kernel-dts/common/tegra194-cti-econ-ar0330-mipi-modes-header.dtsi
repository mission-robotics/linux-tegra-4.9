#define SENSOR_MODE0			mclk_khz = "24000"; \
								discontinuous_clk = "no"; \
								cil_settletime = "0"; \
								dpcm_enable = "false"; \
								active_h = "480"; \
								active_w = "640"; \
								mode_type = "yuv"; \
								readout_orientation = "90"; \
								csi_pixel_bit_depth = "16"; \
								dynamic_pixel_bit_depth = "16"; \
								pixel_phase = "uyvy"; \
								line_length = "3448"; \
								mclk_multiplier = "9.33"; \
								pix_clk_hz = "182400000"; \
								inherent_gain = "1"; \
								min_gain_val = "16"; \
								max_gain_val = "170"; \
								min_exp_time = "13"; \
								max_exp_time = "683709"; \
								min_hdr_ratio = "1"; \
								max_hdr_ratio = "1"; \
								min_framerate = "2000000"; \
								max_framerate = "60000000"; \
								embedded_metadata_height = "0"; \
								default_gain = "16"; \
								step_gain_val = "1"; \
								default_framerate = "60000000"; \
								step_framerate = "1"; 
								
#define SENSOR_MODE1			mclk_khz = "24000"; \
								discontinuous_clk = "no"; \
								cil_settletime = "0"; \
								dpcm_enable = "false"; \
								active_h = "720"; \
								active_w = "1280"; \
								mode_type = "yuv"; \
								readout_orientation = "90"; \
								csi_pixel_bit_depth = "16"; \
								dynamic_pixel_bit_depth = "16"; \
								pixel_phase = "uyvy"; \
								line_length = "3448"; \
								mclk_multiplier = "9.33"; \
								pix_clk_hz = "182400000"; \
								inherent_gain = "1"; \
								min_gain_val = "16"; \
								max_gain_val = "170"; \
								min_exp_time = "13"; \
								max_exp_time = "683709"; \
								min_hdr_ratio = "1"; \
								max_hdr_ratio = "1"; \
								min_framerate = "2000000"; \
								max_framerate = "60000000"; \
								embedded_metadata_height = "0"; \
								default_gain = "16"; \
								step_gain_val = "1"; \
								default_exp_time = "2495"; \
								step_exp_time = "1"; \
								step_framerate = "1"; 
								
#define SENSOR_MODE2			mclk_khz = "24000"; \
								discontinuous_clk = "no"; \
								cil_settletime = "0"; \
								dpcm_enable = "false"; \
								active_h = "1080"; \
								active_w = "1920"; \
								mode_type = "yuv"; \
								readout_orientation = "90"; \
								csi_pixel_bit_depth = "16"; \
								pixel_phase = "uyvy"; \
								line_length = "3448"; \
								mclk_multiplier = "9.33"; \
								pix_clk_hz = "182400000"; \
								inherent_gain = "1"; \
								min_gain_val = "16"; \
								max_gain_val = "170"; \
								min_exp_time = "13"; \
								max_exp_time = "683709"; \
								min_hdr_ratio = "1"; \
								max_hdr_ratio = "1"; \
								min_framerate = "2000000"; \
								max_framerate = "60000000"; \
								embedded_metadata_height = "0"; \
								gain_factor = "16"; \
								default_gain = "16"; \
								step_gain_val = "1"; \
								exposure_factor = "1000000"; \
								default_exp_time = "2495"; \
								step_exp_time = "1"; \
								framerate_factor = "1000000"; \
								default_framerate = "60000000"; \
								step_framerate = "1"; 
								
#define SENSOR_MODE3			mclk_khz = "24000"; \
								discontinuous_clk = "no"; \
								cil_settletime = "0"; \
								dpcm_enable = "false"; \
								active_h = "1296"; \
								active_w = "2304"; \
								mode_type = "yuv"; \
								readout_orientation = "90"; \
								csi_pixel_bit_depth = "16"; \
								dynamic_pixel_bit_depth = "16"; \
								pixel_phase = "uyvy"; \
								line_length = "3448"; \
								mclk_multiplier = "9.33"; \
								pix_clk_hz = "182400000"; \
								inherent_gain = "1"; \
								min_gain_val = "16"; \
								max_gain_val = "170"; \
								min_exp_time = "13"; \
								max_exp_time = "683709"; \
								min_hdr_ratio = "1"; \
								max_hdr_ratio = "1"; \
								min_framerate = "2000000"; \
								max_framerate = "45000000"; \
								embedded_metadata_height = "0"; \
								default_gain = "16"; \
								step_gain_val = "1"; \
								default_exp_time = "2495"; \
								step_exp_time = "1"; \
								step_framerate = "1"; 
								
#define SENSOR_MODE4			mclk_khz = "24000"; \
								discontinuous_clk = "no"; \
								cil_settletime = "0"; \
								dpcm_enable = "false"; \
								active_h = "1536"; \
								active_w = "2304"; \
								mode_type = "yuv"; \
								readout_orientation = "90"; \
								csi_pixel_bit_depth = "16"; \
								dynamic_pixel_bit_depth = "16"; \
								pixel_phase = "uyvy"; \
								line_length = "3448"; \
								mclk_multiplier = "9.33"; \
								pix_clk_hz = "182400000"; \
								inherent_gain = "1"; \
								min_gain_val = "16"; \
								max_gain_val = "170"; \
								min_exp_time = "13"; \
								max_exp_time = "683709"; \
								min_hdr_ratio = "1"; \
								max_hdr_ratio = "1"; \
								min_framerate = "2000000"; \
								max_framerate = "38000000"; \
								embedded_metadata_height = "0"; \
								default_gain = "16"; \
								step_gain_val = "1"; \
								default_framerate = "38000000"; \
								step_framerate = "1"; 

#define SENSOR_MODE5			mclk_khz = "24000"; \
								discontinuous_clk = "no"; \
								cil_settletime = "0"; \
								dpcm_enable = "false"; \
								active_h = "1536"; \
								active_w = "2304"; \
								mode_type = "yuv"; \
								readout_orientation = "90"; \
								csi_pixel_bit_depth = "16"; \
								dynamic_pixel_bit_depth = "16"; \
								pixel_phase = "uyvy"; \
								line_length = "3448"; \
								mclk_multiplier = "9.33"; \
								pix_clk_hz = "182400000"; \
								inherent_gain = "1"; \
								min_gain_val = "16"; \
								max_gain_val = "170"; \
								min_exp_time = "13"; \
								max_exp_time = "683709"; \
								min_hdr_ratio = "1"; \
								max_hdr_ratio = "1"; \
								min_framerate = "2000000"; \
								max_framerate = "38000000"; \
								embedded_metadata_height = "0"; \
								default_gain = "16"; \
								step_gain_val = "1"; \
								default_framerate = "38000000"; \
								step_framerate = "1"; 
								
#define CAM_DATA			physical_w = "3.680"; \
								physical_h = "2.760"; \
								camera_mipi_lanes = <2>; \
								camera-mipi-clk = <1200>; \
								disable-framesync; 
								
/{
	nvidia,dtsfilename = "../econ/e-CAM30_CUNANO_JETSON_XAVIER-NX_L4T32.6.1_dtb.patch";
	nvidia,dtbbuildtime = __DATE__, __TIME__;
};