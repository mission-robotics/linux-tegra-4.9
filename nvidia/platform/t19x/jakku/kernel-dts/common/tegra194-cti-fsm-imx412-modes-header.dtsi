#define SENSOR_MODE0			mclk_khz = "27000"; \
								discontinuous_clk = "no"; \
								cil_settletime = "0"; \
								dpcm_enable = "false"; \
								active_h = "3040"; \
								active_w = "4056"; \
								mode_type = "bayer"; \
								readout_orientation = "0"; \
								csi_pixel_bit_depth = "10"; \
								dynamic_pixel_bit_depth = "10"; \
								pixel_phase = "rggb"; \
								line_length = "4512"; \
								mclk_multiplier = "41.11"; \
								pix_clk_hz = "1110000000"; \
								inherent_gain = "1"; \
								min_gain_val = "1000"; \
								max_gain_val = "356176"; \
								min_exp_time = "7"; \
								max_exp_time = "660000"; \
								min_hdr_ratio = "1"; \
								max_hdr_ratio = "64"; \
								min_framerate = "1500000"; \
								max_framerate = "30000000"; \
								embedded_metadata_height = "2"; \
								gain_factor = "1000"; \
								default_gain = "1000"; \
								step_gain_val = "1"; \
								exposure_factor = "1000000"; \
								default_exp_time = "10000"; \
								step_exp_time = "1"; \
								framerate_factor = "1000000"; \
								default_framerate = "30000000"; \
								step_framerate = "1"; 
								
#define SENSOR_MODE1			mclk_khz = "27000"; \
								discontinuous_clk = "no"; \
								cil_settletime = "0"; \
								dpcm_enable = "false"; \
								active_h = "2160"; \
								active_w = "3840"; \
								mode_type = "bayer"; \
								readout_orientation = "0"; \
								csi_pixel_bit_depth = "10"; \
								dynamic_pixel_bit_depth = "10"; \
								pixel_phase = "rggb"; \
								line_length = "4512"; \
								mclk_multiplier = "41.11"; \
								pix_clk_hz = "1110000000"; \
								inherent_gain = "1"; \
								min_gain_val = "1000"; \
								max_gain_val = "356176"; \
								min_exp_time = "7"; \
								max_exp_time = "660000"; \
								min_hdr_ratio = "1"; \
								max_hdr_ratio = "64"; \
								min_framerate = "1500000"; \
								max_framerate = "42000000"; \
								embedded_metadata_height = "2"; \
								gain_factor = "1000"; \
								default_gain = "1000"; \
								step_gain_val = "1"; \
								exposure_factor = "1000000"; \
								default_exp_time = "10000"; \
								step_exp_time = "1"; \
								framerate_factor = "1000000"; \
								default_framerate = "30000000"; \
								step_framerate = "1"; 
								
#define SENSOR_MODE2			mclk_khz = "27000"; \
								discontinuous_clk = "no"; \
								cil_settletime = "0"; \
								dpcm_enable = "false"; \
								active_h = "720"; \
								active_w = "1280"; \
								mode_type = "bayer"; \
								readout_orientation = "0"; \
								csi_pixel_bit_depth = "10"; \
								dynamic_pixel_bit_depth = "10"; \
								pixel_phase = "rggb"; \
								line_length = "4512"; \
								mclk_multiplier = "41.11"; \
								pix_clk_hz = "1110000000"; \
								inherent_gain = "1"; \
								min_gain_val = "1000"; \
								max_gain_val = "356176"; \
								min_exp_time = "7"; \
								max_exp_time = "660000"; \
								min_hdr_ratio = "1"; \
								max_hdr_ratio = "64"; \
								min_framerate = "1500000"; \
								max_framerate = "30000000"; \
								embedded_metadata_height = "2"; \
								gain_factor = "1000"; \
								default_gain = "1000"; \
								step_gain_val = "1"; \
								exposure_factor = "1000000"; \
								default_exp_time = "10000"; \
								step_exp_time = "1"; \
								framerate_factor = "1000000"; \
								default_framerate = "30000000"; \
								step_framerate = "1"; 
								
#define SENSOR_MODE3			mclk_khz = "27000"; \
								discontinuous_clk = "no"; \
								cil_settletime = "0"; \
								dpcm_enable = "false"; \
								active_h = "1080"; \
								active_w = "1920"; \
								mode_type = "bayer"; \
								readout_orientation = "0"; \
								csi_pixel_bit_depth = "10"; \
								dynamic_pixel_bit_depth = "10"; \
								pixel_phase = "rggb"; \
								line_length = "4512"; \
								mclk_multiplier = "41.11"; \
								pix_clk_hz = "1110000000"; \
								inherent_gain = "1"; \
								min_gain_val = "1000"; \
								max_gain_val = "356176"; \
								min_exp_time = "7"; \
								max_exp_time = "660000"; \
								min_hdr_ratio = "1"; \
								max_hdr_ratio = "64"; \
								min_framerate = "1500000"; \
								max_framerate = "124000000"; \
								embedded_metadata_height = "2"; \
								gain_factor = "1000"; \
								default_gain = "1000"; \
								step_gain_val = "1"; \
								exposure_factor = "1000000"; \
								default_exp_time = "10000"; \
								step_exp_time = "1"; \
								framerate_factor = "1000000"; \
								default_framerate = "120000000"; \
								step_framerate = "1"; 
								
#define SENSOR_MODE4			mclk_khz = "27000"; \
								discontinuous_clk = "no"; \
								cil_settletime = "0"; \
								dpcm_enable = "false"; \
								active_h = "3040"; \
								active_w = "4056"; \
								mode_type = "bayer"; \
								readout_orientation = "0"; \
								csi_pixel_bit_depth = "12"; \
								dynamic_pixel_bit_depth = "12"; \
								pixel_phase = "rggb"; \
								line_length = "4512"; \
								mclk_multiplier = "41.11"; \
								pix_clk_hz = "1110000000"; \
								inherent_gain = "1"; \
								min_gain_val = "1000"; \
								max_gain_val = "356176"; \
								min_exp_time = "7"; \
								max_exp_time = "660000"; \
								min_hdr_ratio = "1"; \
								max_hdr_ratio = "64"; \
								min_framerate = "1500000"; \
								max_framerate = "22000000"; \
								embedded_metadata_height = "2"; \
								gain_factor = "1000"; \
								default_gain = "1000"; \
								step_gain_val = "1"; \
								exposure_factor = "1000000"; \
								default_exp_time = "10000"; \
								step_exp_time = "1"; \
								framerate_factor = "1000000"; \
								default_framerate = "22000000"; \
								step_framerate = "1"; 
								
#define SENSOR_MODE5			mclk_khz = "27000"; \
								discontinuous_clk = "no"; \
								cil_settletime = "0"; \
								dpcm_enable = "false"; \
								active_h = "2160"; \
								active_w = "3840"; \
								mode_type = "bayer"; \
								readout_orientation = "0"; \
								csi_pixel_bit_depth = "12"; \
								dynamic_pixel_bit_depth = "12"; \
								pixel_phase = "rggb"; \
								line_length = "4512"; \
								mclk_multiplier = "41.11"; \
								pix_clk_hz = "1110000000"; \
								inherent_gain = "1"; \
								min_gain_val = "1000"; \
								max_gain_val = "356176"; \
								min_exp_time = "7"; \
								max_exp_time = "660000"; \
								min_hdr_ratio = "1"; \
								max_hdr_ratio = "64"; \
								min_framerate = "1500000"; \
								max_framerate = "31000000"; \
								embedded_metadata_height = "2"; \
								gain_factor = "1000"; \
								default_gain = "1000"; \
								step_gain_val = "1"; \
								exposure_factor = "1000000"; \
								default_exp_time = "10000"; \
								step_exp_time = "1"; \
								framerate_factor = "1000000"; \
								default_framerate = "30000000"; \
								step_framerate = "1"; 
								
#define SENSOR_MODE6			mclk_khz = "27000"; \
								discontinuous_clk = "no"; \
								cil_settletime = "0"; \
								dpcm_enable = "false"; \
								active_h = "720"; \
								active_w = "1280"; \
								mode_type = "bayer"; \
								readout_orientation = "0"; \
								csi_pixel_bit_depth = "12"; \
								dynamic_pixel_bit_depth = "12"; \
								pixel_phase = "rggb"; \
								line_length = "4512"; \
								mclk_multiplier = "41.11"; \
								pix_clk_hz = "1110000000"; \
								inherent_gain = "1"; \
								min_gain_val = "1000"; \
								max_gain_val = "356176"; \
								min_exp_time = "7"; \
								max_exp_time = "660000"; \
								min_hdr_ratio = "1"; \
								max_hdr_ratio = "64"; \
								min_framerate = "1500000"; \
								max_framerate = "22000000"; \
								embedded_metadata_height = "2"; \
								gain_factor = "1000"; \
								default_gain = "1000"; \
								step_gain_val = "1"; \
								exposure_factor = "1000000"; \
								default_exp_time = "10000"; \
								step_exp_time = "1"; \
								framerate_factor = "1000000"; \
								default_framerate = "22000000"; \
								step_framerate = "1"; 
								
/{
	nvidia,dtsfilename = "../../../../framos/FRAMOS_IMX412-Driver-Source_Jetson-Xavier-NX/patch/imx412_common_dtree.patch";
	nvidia,dtbbuildtime = __DATE__, __TIME__;
};