#define SENSOR_MODE0			mclk_khz = "37125"; \
								discontinuous_clk = "no"; \
								cil_settletime = "0"; \
								dpcm_enable = "false"; \
								active_h = "2180"; \
								active_w = "3856"; \
								mode_type = "bayer"; \
								readout_orientation = "0"; \
								csi_pixel_bit_depth = "12"; \
								dynamic_pixel_bit_depth = "12"; \
								pixel_phase = "rggb"; \
								line_length = "6600"; \
								mclk_multiplier = "40.40"; \
								pix_clk_hz = "1500000000"; \
								inherent_gain = "1"; \
								min_gain_val = "0"; \
								max_gain_val = "720"; \
								min_exp_time = "27"; \
								max_exp_time = "660000"; \
								min_hdr_ratio = "1"; \
								max_hdr_ratio = "64"; \
								min_framerate = "1500000"; \
								max_framerate = "30000000"; \
								embedded_metadata_height = "0"; \
								gain_factor = "10"; \
								default_gain = "0"; \
								step_gain_val = "3"; \
								exposure_factor = "1000000"; \
								default_exp_time = "10000"; \
								step_exp_time = "1"; \
								framerate_factor = "1000000"; \
								default_framerate = "30000000"; \
								step_framerate = "1"; 
								
#define SENSOR_MODE1			mclk_khz = "37125"; \
								discontinuous_clk = "no"; \
								cil_settletime = "0"; \
								dpcm_enable = "false"; \
								active_h = "1080"; \
								active_w = "1920"; \
								mode_type = "bayer"; \
								readout_orientation = "0"; \
								csi_pixel_bit_depth = "12"; \
								dynamic_pixel_bit_depth = "12"; \
								pixel_phase = "rggb"; \
								line_length = "6600"; \
								mclk_multiplier = "40.40"; \
								pix_clk_hz = "1500000000"; \
								inherent_gain = "1"; \
								min_gain_val = "0"; \
								max_gain_val = "720"; \
								min_exp_time = "27"; \
								max_exp_time = "660000"; \
								min_hdr_ratio = "1"; \
								max_hdr_ratio = "64"; \
								min_framerate = "1500000"; \
								max_framerate = "59000000"; \
								embedded_metadata_height = "0"; \
								gain_factor = "10"; \
								default_gain = "0"; \
								step_gain_val = "3"; \
								exposure_factor = "1000000"; \
								default_exp_time = "10000"; \
								step_exp_time = "1"; \
								framerate_factor = "1000000"; \
								default_framerate = "59000000"; \
								step_framerate = "1"; 
								
#define SENSOR_MODE2			mclk_khz = "37125"; \
								discontinuous_clk = "no"; \
								cil_settletime = "0"; \
								dpcm_enable = "false"; \
								active_h = "1090"; \
								active_w = "1928"; \
								mode_type = "bayer"; \
								readout_orientation = "0"; \
								csi_pixel_bit_depth = "12"; \
								dynamic_pixel_bit_depth = "12"; \
								pixel_phase = "rggb"; \
								line_length = "6600"; \
								mclk_multiplier = "40.40"; \
								pix_clk_hz = "1500000000"; \
								inherent_gain = "1"; \
								min_gain_val = "0"; \
								max_gain_val = "720"; \
								min_exp_time = "27"; \
								max_exp_time = "660000"; \
								min_hdr_ratio = "1"; \
								max_hdr_ratio = "64"; \
								min_framerate = "1500000"; \
								max_framerate = "30000000"; \
								embedded_metadata_height = "0"; \
								gain_factor = "10"; \
								default_gain = "0"; \
								step_gain_val = "3"; \
								exposure_factor = "1000000"; \
								default_exp_time = "10000"; \
								step_exp_time = "1"; \
								framerate_factor = "1000000"; \
								default_framerate = "30000000"; \
								step_framerate = "1"; 
								
#define SENSOR_MODE3			mclk_khz = "37125"; \
								discontinuous_clk = "no"; \
								cil_settletime = "0"; \
								dpcm_enable = "false"; \
								active_h = "2180"; \
								active_w = "3856"; \
								mode_type = "bayer"; \
								readout_orientation = "0"; \
								csi_pixel_bit_depth = "10"; \
								dynamic_pixel_bit_depth = "10"; \
								pixel_phase = "rggb"; \
								line_length = "6600"; \
								mclk_multiplier = "40.40"; \
								pix_clk_hz = "1500000000"; \
								inherent_gain = "1"; \
								min_gain_val = "0"; \
								max_gain_val = "720"; \
								min_exp_time = "27"; \
								max_exp_time = "660000"; \
								min_hdr_ratio = "1"; \
								max_hdr_ratio = "64"; \
								min_framerate = "1500000"; \
								max_framerate = "30000000"; \
								embedded_metadata_height = "0"; \
								gain_factor = "10"; \
								default_gain = "0"; \
								step_gain_val = "3"; \
								exposure_factor = "1000000"; \
								default_exp_time = "10000"; \
								step_exp_time = "1"; \
								framerate_factor = "1000000"; \
								default_framerate = "30000000"; \
								step_framerate = "1"; 
								
#define SENSOR_MODE4			mclk_khz = "37125"; \
								discontinuous_clk = "no"; \
								cil_settletime = "0"; \
								dpcm_enable = "false"; \
								active_h = "1080"; \
								active_w = "1920"; \
								mode_type = "bayer"; \
								readout_orientation = "0"; \
								csi_pixel_bit_depth = "10"; \
								dynamic_pixel_bit_depth = "10"; \
								pixel_phase = "rggb"; \
								line_length = "6600"; \
								mclk_multiplier = "40.40"; \
								pix_clk_hz = "1500000000"; \
								inherent_gain = "1"; \
								min_gain_val = "0"; \
								max_gain_val = "720"; \
								min_exp_time = "27"; \
								max_exp_time = "660000"; \
								min_hdr_ratio = "1"; \
								max_hdr_ratio = "64"; \
								min_framerate = "1500000"; \
								max_framerate = "59000000"; \
								embedded_metadata_height = "0"; \
								gain_factor = "10"; \
								default_gain = "0"; \
								step_gain_val = "3"; \
								exposure_factor = "1000000"; \
								default_exp_time = "10000"; \
								step_exp_time = "1"; \
								framerate_factor = "1000000"; \
								default_framerate = "59000000"; \
								step_framerate = "1"; 
								
/{
	nvidia,dtsfilename = "tegra194-p3668-all-p3509-0000-imx585-CAM0-2lane.dts";
	nvidia,dtbbuildtime = __DATE__, __TIME__;
};
