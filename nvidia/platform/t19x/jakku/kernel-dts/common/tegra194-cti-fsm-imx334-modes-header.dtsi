#define SENSOR_MODE0			mclk_khz = "37125"; \
								discontinuous_clk = "no"; \
								cil_settletime = "0"; \
								dpcm_enable = "false"; \
								active_h = "2180"; \
								active_w = "3864"; \
								mode_type = "bayer"; \
								readout_orientation = "0"; \
								csi_pixel_bit_depth = "10"; \
								dynamic_pixel_bit_depth = "10"; \
								pixel_phase = "rggb"; \
								line_length = "6600"; \
								mclk_multiplier = "20.48"; \
								pix_clk_hz = "760000000"; \
								inherent_gain = "1"; \
								min_gain_val = "0"; \
								max_gain_val = "720"; \
								min_exp_time = "7"; \
								max_exp_time = "660000"; \
								min_hdr_ratio = "1"; \
								max_hdr_ratio = "64"; \
								min_framerate = "1500000"; \
								max_framerate = "60000000"; \
								embedded_metadata_height = "1"; \
								gain_factor = "10"; \
								default_gain = "0"; \
								step_gain_val = "3"; \
								exposure_factor = "1000000"; \
								default_exp_time = "10000"; \
								step_exp_time = "1"; \
								framerate_factor = "1000000"; \
								default_framerate = "60000000"; \
								step_framerate = "1"; 
								
#define SENSOR_MODE1			mclk_khz = "37125"; \
								discontinuous_clk = "no"; \
								cil_settletime = "0"; \
								dpcm_enable = "false"; \
								active_h = "1080"; \
								active_w = "1920"; \
								mode_type = "bayer"; \
								readout_orientation = "0"; \
								csi_pixel_bit_depth = "10"; \
								dynamic_pixel_bit_depth = "10"; \
								pixel_phase = "rggb"; \
								line_length = "6600"; \
								mclk_multiplier = "20.48"; \
								pix_clk_hz = "760000000"; \
								inherent_gain = "1"; \
								min_gain_val = "0"; \
								max_gain_val = "720"; \
								min_exp_time = "7"; \
								max_exp_time = "660000"; \
								min_hdr_ratio = "1"; \
								max_hdr_ratio = "64"; \
								min_framerate = "1500000"; \
								max_framerate = "120000000"; \
								embedded_metadata_height = "1"; \
								gain_factor = "10"; \
								default_gain = "0"; \
								step_gain_val = "3"; \
								exposure_factor = "1000000"; \
								default_exp_time = "10000"; \
								step_exp_time = "1"; \
								framerate_factor = "1000000"; \
								default_framerate = "120000000"; \
								step_framerate = "1"; 
								
#define SENSOR_MODE2			mclk_khz = "37125"; \
								discontinuous_clk = "no"; \
								cil_settletime = "0"; \
								dpcm_enable = "false"; \
								active_h = "1080"; \
								active_w = "1944"; \
								mode_type = "bayer"; \
								readout_orientation = "0"; \
								csi_pixel_bit_depth = "12"; \
								dynamic_pixel_bit_depth = "12"; \
								pixel_phase = "rggb"; \
								line_length = "6600"; \
								mclk_multiplier = "20.48"; \
								pix_clk_hz = "760000000"; \
								inherent_gain = "1"; \
								min_gain_val = "0"; \
								max_gain_val = "720"; \
								min_exp_time = "14"; \
								max_exp_time = "660000"; \
								min_hdr_ratio = "1"; \
								max_hdr_ratio = "64"; \
								min_framerate = "1500000"; \
								max_framerate = "60000000"; \
								embedded_metadata_height = "1"; \
								gain_factor = "10"; \
								default_gain = "0"; \
								step_gain_val = "3"; \
								exposure_factor = "1000000"; \
								default_exp_time = "10000"; \
								step_exp_time = "1"; \
								framerate_factor = "1000000"; \
								default_framerate = "60000000"; \
								step_framerate = "1"; 
								
#define SENSOR_MODE3			mclk_khz = "37125"; \
								discontinuous_clk = "no"; \
								cil_settletime = "0"; \
								dpcm_enable = "false"; \
								active_h = "2180"; \
								active_w = "3864"; \
								mode_type = "bayer"; \
								readout_orientation = "0"; \
								csi_pixel_bit_depth = "12"; \
								dynamic_pixel_bit_depth = "12"; \
								pixel_phase = "rggb"; \
								line_length = "6600"; \
								mclk_multiplier = "20.48"; \
								pix_clk_hz = "760000000"; \
								inherent_gain = "1"; \
								min_gain_val = "0"; \
								max_gain_val = "720"; \
								min_exp_time = "7"; \
								max_exp_time = "660000"; \
								min_hdr_ratio = "1"; \
								max_hdr_ratio = "64"; \
								min_framerate = "1500000"; \
								max_framerate = "60000000"; \
								embedded_metadata_height = "1"; \
								gain_factor = "10"; \
								default_gain = "0"; \
								step_gain_val = "3"; \
								exposure_factor = "1000000"; \
								default_exp_time = "10000"; \
								step_exp_time = "1"; \
								framerate_factor = "1000000"; \
								default_framerate = "60000000"; \
								step_framerate = "1"; 
								
#define SENSOR_MODE4			mclk_khz = "37125"; \
								discontinuous_clk = "no"; \
								cil_settletime = "0"; \
								dpcm_enable = "false"; \
								active_h = "1080"; \
								active_w = "1920"; \
								mode_type = "bayer"; \
								readout_orientation = "0"; \
								csi_pixel_bit_depth = "12"; \
								dynamic_pixel_bit_depth = "12"; \
								pixel_phase = "rggb"; \
								line_length = "6600"; \
								mclk_multiplier = "20.48"; \
								pix_clk_hz = "760000000"; \
								inherent_gain = "1"; \
								min_gain_val = "0"; \
								max_gain_val = "720"; \
								min_exp_time = "7"; \
								max_exp_time = "660000"; \
								min_hdr_ratio = "1"; \
								max_hdr_ratio = "64"; \
								min_framerate = "1500000"; \
								max_framerate = "120000000"; \
								embedded_metadata_height = "1"; \
								gain_factor = "10"; \
								default_gain = "0"; \
								step_gain_val = "3"; \
								exposure_factor = "1000000"; \
								default_exp_time = "10000"; \
								step_exp_time = "1"; \
								framerate_factor = "1000000"; \
								default_framerate = "120000000"; \
								step_framerate = "1"; 
								
/{
	nvidia,dtsfilename = "/home/sweng/framos/FRAMOS_IMX334-Driver-Source_Jetson-Xavier/patch/imx334_common_dtree.patch";
	nvidia,dtbbuildtime = __DATE__, __TIME__;
};