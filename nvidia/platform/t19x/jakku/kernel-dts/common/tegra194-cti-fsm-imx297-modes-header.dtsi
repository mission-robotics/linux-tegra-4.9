#define SENSOR_MODE0			mclk_khz = "37125"; \
								discontinuous_clk = "no"; \
								cil_settletime = "0"; \
								dpcm_enable = "false"; \
								active_h = "544"; \
								active_w = "728"; \
								mode_type = "bayer"; \
								readout_orientation = "0"; \
								csi_pixel_bit_depth = "10"; \
								dynamic_pixel_bit_depth = "10"; \
								pixel_phase = "rggb"; \
								line_length = "1712"; \
								mclk_multiplier = "6.74"; \
								pix_clk_hz = "250000000"; \
								inherent_gain = "1"; \
								min_gain_val = "0"; \
								max_gain_val = "480"; \
								min_exp_time = "28"; \
								max_exp_time = "660000"; \
								min_hdr_ratio = "1"; \
								max_hdr_ratio = "64"; \
								min_framerate = "1500000"; \
								max_framerate = "121000000"; \
								embedded_metadata_height = "2"; \
								gain_factor = "10"; \
								default_gain = "0"; \
								step_gain_val = "1"; \
								exposure_factor = "1000000"; \
								default_exp_time = "10000"; \
								step_exp_time = "1"; \
								framerate_factor = "1000000"; \
								default_framerate = "121000000"; \
								step_framerate = "1"; 
								
#define SENSOR_MODE1			mclk_khz = "37125"; \
								discontinuous_clk = "no"; \
								cil_settletime = "0"; \
								dpcm_enable = "false"; \
								active_h = "480"; \
								active_w = "640"; \
								mode_type = "bayer"; \
								readout_orientation = "0"; \
								csi_pixel_bit_depth = "10"; \
								dynamic_pixel_bit_depth = "10"; \
								pixel_phase = "rggb"; \
								line_length = "1712"; \
								mclk_multiplier = "6.74"; \
								pix_clk_hz = "250000000"; \
								inherent_gain = "1"; \
								min_gain_val = "0"; \
								max_gain_val = "480"; \
								min_exp_time = "28"; \
								max_exp_time = "660000"; \
								min_hdr_ratio = "1"; \
								max_hdr_ratio = "64"; \
								min_framerate = "1500000"; \
								max_framerate = "136000000"; \
								embedded_metadata_height = "2"; \
								gain_factor = "10"; \
								default_gain = "0"; \
								step_gain_val = "1"; \
								exposure_factor = "1000000"; \
								default_exp_time = "10000"; \
								step_exp_time = "1"; \
								framerate_factor = "1000000"; \
								default_framerate = "120000000"; \
								step_framerate = "1"; 
																
#define SENSOR_MODE2			mclk_khz = "37125"; \
								discontinuous_clk = "no"; \
								cil_settletime = "0"; \
								dpcm_enable = "false"; \
								active_h = "544"; \
								active_w = "728"; \
								mode_type = "bayer"; \
								readout_orientation = "0"; \
								csi_pixel_bit_depth = "10"; \
								dynamic_pixel_bit_depth = "10"; \
								pixel_phase = "rggb"; \
								line_length = "1712"; \
								mclk_multiplier = "6.74"; \
								pix_clk_hz = "250000000"; \
								inherent_gain = "1"; \
								min_gain_val = "0"; \
								max_gain_val = "480"; \
								min_exp_time = "28"; \
								max_exp_time = "660000"; \
								min_hdr_ratio = "1"; \
								max_hdr_ratio = "64"; \
								min_framerate = "1500000"; \
								max_framerate = "121000000"; \
								embedded_metadata_height = "2"; \
								gain_factor = "10"; \
								default_gain = "0"; \
								step_gain_val = "1"; \
								exposure_factor = "1000000"; \
								default_exp_time = "10000"; \
								step_exp_time = "1"; \
								framerate_factor = "1000000"; \
								default_framerate = "121000000"; \
								step_framerate = "1"; 
								
#define SENSOR_MODE3			mclk_khz = "37125"; \
								discontinuous_clk = "no"; \
								cil_settletime = "0"; \
								dpcm_enable = "false"; \
								active_h = "544"; \
								active_w = "728"; \
								mode_type = "bayer"; \
								readout_orientation = "0"; \
								csi_pixel_bit_depth = "10"; \
								dynamic_pixel_bit_depth = "10"; \
								pixel_phase = "rggb"; \
								line_length = "1712"; \
								mclk_multiplier = "6.74"; \
								pix_clk_hz = "250000000"; \
								inherent_gain = "1"; \
								min_gain_val = "0"; \
								max_gain_val = "480"; \
								min_exp_time = "28"; \
								max_exp_time = "660000"; \
								min_hdr_ratio = "1"; \
								max_hdr_ratio = "64"; \
								min_framerate = "1500000"; \
								max_framerate = "121000000"; \
								embedded_metadata_height = "2"; \
								gain_factor = "10"; \
								default_gain = "0"; \
								step_gain_val = "1"; \
								exposure_factor = "1000000"; \
								default_exp_time = "10000"; \
								step_exp_time = "1"; \
								framerate_factor = "1000000"; \
								default_framerate = "121000000"; \
								step_framerate = "1"; 
								
#define SENSOR_MODE4			mclk_khz = "37125"; \
								discontinuous_clk = "no"; \
								cil_settletime = "0"; \
								dpcm_enable = "false"; \
								active_h = "544"; \
								active_w = "728"; \
								mode_type = "bayer"; \
								readout_orientation = "0"; \
								csi_pixel_bit_depth = "10"; \
								dynamic_pixel_bit_depth = "10"; \
								pixel_phase = "rggb"; \
								line_length = "1712"; \
								mclk_multiplier = "6.74"; \
								pix_clk_hz = "250000000"; \
								inherent_gain = "1"; \
								min_gain_val = "0"; \
								max_gain_val = "480"; \
								min_exp_time = "28"; \
								max_exp_time = "660000"; \
								min_hdr_ratio = "1"; \
								max_hdr_ratio = "64"; \
								min_framerate = "1500000"; \
								max_framerate = "121000000"; \
								embedded_metadata_height = "2"; \
								gain_factor = "10"; \
								default_gain = "0"; \
								step_gain_val = "1"; \
								exposure_factor = "1000000"; \
								default_exp_time = "10000"; \
								step_exp_time = "1"; \
								framerate_factor = "1000000"; \
								default_framerate = "121000000"; \
								step_framerate = "1"; 
								
#define CAM_DATA			physical_w = "14.0"; \
								physical_h = "14.0"; \
								post_crop_frame_drop = "0"; \
								use_decibel_gain = "true"; \
								delayed_gain = "false"; \
								use_sensor_mode_id = "false"; 
								
/{
	nvidia,dtsfilename = "../framos/FRAMOS_IMX297-Driver-Source_Jetson-Xavier-NX/patch/imx297_common_dtree.patch";
	nvidia,dtbbuildtime = __DATE__, __TIME__;
};