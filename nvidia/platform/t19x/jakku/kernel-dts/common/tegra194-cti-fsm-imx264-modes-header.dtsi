#define SENSOR_MODE0			mclk_khz = "37125"; \
								discontinuous_clk = "no"; \
								cil_settletime = "0"; \
								dpcm_enable = "false"; \
								active_h = "2056"; \
								active_w = "2464"; \
								mode_type = "bayer"; \
								readout_orientation = "0"; \
								csi_pixel_bit_depth = "12"; \
								dynamic_pixel_bit_depth = "12"; \
								pixel_phase = "rggb"; \
								line_length = "2464"; \
								mclk_multiplier = "44.44"; \
								pix_clk_hz = "1200000000"; \
								inherent_gain = "1"; \
								min_gain_val = "0"; \
								max_gain_val = "480"; \
								min_exp_time = "27"; \
								max_exp_time = "660000"; \
								min_hdr_ratio = "1"; \
								max_hdr_ratio = "64"; \
								min_framerate = "1500000"; \
								max_framerate = "36000000"; \
								embedded_metadata_height = "0"; \
								gain_factor = "10"; \
								default_gain = "0"; \
								step_gain_val = "1"; \
								exposure_factor = "1000000"; \
								default_exp_time = "22879"; \
								step_exp_time = "1"; \
								framerate_factor = "1000000"; \
								default_framerate = "36000000"; \
								step_framerate = "1"; 
								
#define SENSOR_MODE1			mclk_khz = "37125"; \
								discontinuous_clk = "no"; \
								cil_settletime = "0"; \
								dpcm_enable = "false"; \
								active_h = "1536"; \
								active_w = "2048"; \
								mode_type = "bayer"; \
								readout_orientation = "0"; \
								csi_pixel_bit_depth = "12"; \
								dynamic_pixel_bit_depth = "12"; \
								pixel_phase = "rggb"; \
								line_length = "2048"; \
								mclk_multiplier = "44.44"; \
								pix_clk_hz = "1200000000"; \
								inherent_gain = "1"; \
								min_gain_val = "0"; \
								max_gain_val = "480"; \
								min_exp_time = "27"; \
								max_exp_time = "660000"; \
								min_hdr_ratio = "1"; \
								max_hdr_ratio = "64"; \
								min_framerate = "1500000"; \
								max_framerate = "48000000"; \
								embedded_metadata_height = "0"; \
								gain_factor = "10"; \
								default_gain = "0"; \
								step_gain_val = "1"; \
								exposure_factor = "1000000"; \
								default_exp_time = "20906"; \
								step_exp_time = "1"; \
								framerate_factor = "1000000"; \
								default_framerate = "30000000"; \
								step_framerate = "1"; 
								
#define SENSOR_MODE2			mclk_khz = "37125"; \
								discontinuous_clk = "no"; \
								cil_settletime = "0"; \
								dpcm_enable = "false"; \
								active_h = "1096"; \
								active_w = "1936"; \
								mode_type = "bayer"; \
								readout_orientation = "0"; \
								csi_pixel_bit_depth = "12"; \
								dynamic_pixel_bit_depth = "12"; \
								pixel_phase = "rggb"; \
								line_length = "1936"; \
								mclk_multiplier = "44.44"; \
								pix_clk_hz = "1200000000"; \
								inherent_gain = "1"; \
								min_gain_val = "0"; \
								max_gain_val = "480"; \
								min_exp_time = "29"; \
								max_exp_time = "660000"; \
								min_hdr_ratio = "1"; \
								max_hdr_ratio = "64"; \
								min_framerate = "1500000"; \
								max_framerate = "60000000"; \
								embedded_metadata_height = "0"; \
								gain_factor = "10"; \
								default_gain = "0"; \
								step_gain_val = "1"; \
								exposure_factor = "1000000"; \
								default_exp_time = "10000"; \
								step_exp_time = "1"; \
								framerate_factor = "1000000"; \
								default_framerate = "60000000"; \
								step_framerate = "1"; 
								
#define SENSOR_MODE3			mclk_khz = "37125"; \
								discontinuous_clk = "no"; \
								cil_settletime = "0"; \
								dpcm_enable = "false"; \
								active_h = "2056"; \
								active_w = "2464"; \
								mode_type = "bayer"; \
								readout_orientation = "0"; \
								csi_pixel_bit_depth = "12"; \
								dynamic_pixel_bit_depth = "12"; \
								pixel_phase = "rggb"; \
								line_length = "2464"; \
								mclk_multiplier = "44.44"; \
								pix_clk_hz = "1200000000"; \
								inherent_gain = "1"; \
								min_gain_val = "0"; \
								max_gain_val = "480"; \
								min_exp_time = "27"; \
								max_exp_time = "660000"; \
								min_hdr_ratio = "1"; \
								max_hdr_ratio = "64"; \
								min_framerate = "1500000"; \
								max_framerate = "36000000"; \
								embedded_metadata_height = "0"; \
								gain_factor = "10"; \
								default_gain = "0"; \
								step_gain_val = "1"; \
								exposure_factor = "1000000"; \
								default_exp_time = "22879"; \
								step_exp_time = "1"; \
								framerate_factor = "1000000"; \
								default_framerate = "36000000"; \
								step_framerate = "1"; 
								
#define SENSOR_MODE1			mclk_khz = "37125"; \
								discontinuous_clk = "no"; \
								cil_settletime = "0"; \
								dpcm_enable = "false"; \
								active_h = "1536"; \
								active_w = "2048"; \
								mode_type = "bayer"; \
								readout_orientation = "0"; \
								csi_pixel_bit_depth = "12"; \
								dynamic_pixel_bit_depth = "12"; \
								pixel_phase = "rggb"; \
								line_length = "2048"; \
								mclk_multiplier = "44.44"; \
								pix_clk_hz = "1200000000"; \
								inherent_gain = "1"; \
								min_gain_val = "0"; \
								max_gain_val = "480"; \
								min_exp_time = "27"; \
								max_exp_time = "660000"; \
								min_hdr_ratio = "1"; \
								max_hdr_ratio = "64"; \
								min_framerate = "1500000"; \
								max_framerate = "48000000"; \
								embedded_metadata_height = "0"; \
								gain_factor = "10"; \
								default_gain = "0"; \
								step_gain_val = "1"; \
								exposure_factor = "1000000"; \
								default_exp_time = "20906"; \
								step_exp_time = "1"; \
								framerate_factor = "1000000"; \
								default_framerate = "30000000"; \
								step_framerate = "1"; 
								
#define SENSOR_MODE2			mclk_khz = "37125"; \
								discontinuous_clk = "no"; \
								cil_settletime = "0"; \
								dpcm_enable = "false"; \
								active_h = "1096"; \
								active_w = "1936"; \
								mode_type = "bayer"; \
								readout_orientation = "0"; \
								csi_pixel_bit_depth = "12"; \
								dynamic_pixel_bit_depth = "12"; \
								pixel_phase = "rggb"; \
								line_length = "1936"; \
								mclk_multiplier = "44.44"; \
								pix_clk_hz = "1200000000"; \
								inherent_gain = "1"; \
								min_gain_val = "0"; \
								max_gain_val = "480"; \
								min_exp_time = "29"; \
								max_exp_time = "660000"; \
								min_hdr_ratio = "1"; \
								max_hdr_ratio = "64"; \
								min_framerate = "1500000"; \
								max_framerate = "60000000"; \
								embedded_metadata_height = "0"; \
								gain_factor = "10"; \
								default_gain = "0"; \
								step_gain_val = "1"; \
								exposure_factor = "1000000"; \
								default_exp_time = "10000"; \
								step_exp_time = "1"; \
								framerate_factor = "1000000"; \
								default_framerate = "60000000"; \
								step_framerate = "1"; 
								
#define SENSOR_MODE4			mclk_khz = "37125"; \
								discontinuous_clk = "no"; \
								cil_settletime = "0"; \
								dpcm_enable = "false"; \
								active_h = "2056"; \
								active_w = "2464"; \
								mode_type = "bayer"; \
								readout_orientation = "0"; \
								csi_pixel_bit_depth = "12"; \
								dynamic_pixel_bit_depth = "12"; \
								pixel_phase = "rggb"; \
								line_length = "2464"; \
								mclk_multiplier = "44.44"; \
								pix_clk_hz = "1200000000"; \
								inherent_gain = "1"; \
								min_gain_val = "0"; \
								max_gain_val = "480"; \
								min_exp_time = "27"; \
								max_exp_time = "660000"; \
								min_hdr_ratio = "1"; \
								max_hdr_ratio = "64"; \
								min_framerate = "1500000"; \
								max_framerate = "36000000"; \
								embedded_metadata_height = "0"; \
								gain_factor = "10"; \
								default_gain = "0"; \
								step_gain_val = "1"; \
								exposure_factor = "1000000"; \
								default_exp_time = "22879"; \
								step_exp_time = "1"; \
								framerate_factor = "1000000"; \
								default_framerate = "36000000"; \
								step_framerate = "1"; 
								
#define SENSOR_MODE1			mclk_khz = "37125"; \
								discontinuous_clk = "no"; \
								cil_settletime = "0"; \
								dpcm_enable = "false"; \
								active_h = "1536"; \
								active_w = "2048"; \
								mode_type = "bayer"; \
								readout_orientation = "0"; \
								csi_pixel_bit_depth = "12"; \
								dynamic_pixel_bit_depth = "12"; \
								pixel_phase = "rggb"; \
								line_length = "2048"; \
								mclk_multiplier = "44.44"; \
								pix_clk_hz = "1200000000"; \
								inherent_gain = "1"; \
								min_gain_val = "0"; \
								max_gain_val = "480"; \
								min_exp_time = "27"; \
								max_exp_time = "660000"; \
								min_hdr_ratio = "1"; \
								max_hdr_ratio = "64"; \
								min_framerate = "1500000"; \
								max_framerate = "48000000"; \
								embedded_metadata_height = "0"; \
								gain_factor = "10"; \
								default_gain = "0"; \
								step_gain_val = "1"; \
								exposure_factor = "1000000"; \
								default_exp_time = "20906"; \
								step_exp_time = "1"; \
								framerate_factor = "1000000"; \
								default_framerate = "30000000"; \
								step_framerate = "1"; 
								
#define SENSOR_MODE2			mclk_khz = "37125"; \
								discontinuous_clk = "no"; \
								cil_settletime = "0"; \
								dpcm_enable = "false"; \
								active_h = "1096"; \
								active_w = "1936"; \
								mode_type = "bayer"; \
								readout_orientation = "0"; \
								csi_pixel_bit_depth = "12"; \
								dynamic_pixel_bit_depth = "12"; \
								pixel_phase = "rggb"; \
								line_length = "1936"; \
								mclk_multiplier = "44.44"; \
								pix_clk_hz = "1200000000"; \
								inherent_gain = "1"; \
								min_gain_val = "0"; \
								max_gain_val = "480"; \
								min_exp_time = "29"; \
								max_exp_time = "660000"; \
								min_hdr_ratio = "1"; \
								max_hdr_ratio = "64"; \
								min_framerate = "1500000"; \
								max_framerate = "60000000"; \
								embedded_metadata_height = "0"; \
								gain_factor = "10"; \
								default_gain = "0"; \
								step_gain_val = "1"; \
								exposure_factor = "1000000"; \
								default_exp_time = "10000"; \
								step_exp_time = "1"; \
								framerate_factor = "1000000"; \
								default_framerate = "60000000"; \
								step_framerate = "1"; 
								
/{
	nvidia,dtsfilename = "/home/sweng/framos/FRAMOS_IMX264-Driver-Source_Jetson-Xavier/patch/imx264_common_dtree.patch";
	nvidia,dtbbuildtime = __DATE__, __TIME__;
};