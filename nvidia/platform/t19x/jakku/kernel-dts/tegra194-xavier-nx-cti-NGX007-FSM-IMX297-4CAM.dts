#include "tegra194-xavier-nx-cti-NGX007.dts" 
#include "common/tegra194-xavier-nx-cti-NGX007-FSM-IMX297-4CAM.dtsi" 
/{
    nvidia,dtsfilename = "tegra194-xavier-nx-cti-NGX007-FSM-IMX297-4CAM.dts";
    nvidia,dtbbuildtime = __DATE__, __TIME__;
};
